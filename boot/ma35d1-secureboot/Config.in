## boot/ma35d1-secureboot/Config.in
```kconfig
config BR2_ANTI_ROLLBACK_AB_BOOT
	bool "Enable A/B boot and Anti-Rollback"
	depends on BR2_NUVOTON_MA35D1
	depends on BR2_LINUX_KERNEL
	depends on BR2_TARGET_UBOOT_BUILD_SYSTEM_KCONFIG
	depends on BR2_TARGET_ARM_TRUSTED_FIRMWARE_FIP
	depends on BR2_TARGET_ARM_TRUSTED_FIRMWARE_UBOOT_AS_BL33
	depends on BR2_TARGET_ARM_TRUSTED_FIRMWARE_UBOOT_BL33_IMAGE = "u-boot.bin"
	select BR2_TARGET_UBOOT_NEEDS_OPENSSL
	select BR2_PACKAGE_HOST_UBOOT_TOOLS
	select BR2_PACKAGE_HOST_UBOOT_TOOLS_FIT_SUPPORT
	select BR2_PACKAGE_HOST_UBOOT_TOOLS_FIT_SIGNATURE_SUPPORT
	select BR2_TARGET_MA35D1_SECURE_BOOT
	select BR2_TARGET_OTP_ANTI_ROLLBACK
	help
	  Enable dual-slot A/B boot and rollback support for MA35D1
	  SD/eMMC, NAND and SPI-NAND images. SPI-NOR is not supported.
	  Requires MA35 TF-A and U-Boot sources with A/B support.

	  The system keeps two bootable slots, A and B.
	  Normally the active slot is booted first.
	  If booting or validation of the active slot fails,
	  the boot flow can fall back to the other slot.

	  This is typically used for safe firmware update and recovery.

if BR2_ANTI_ROLLBACK_AB_BOOT

menu "A/B Boot & Anti-Rollback Settings"

config BR2_TARGET_MA35_UBOOT_MTDPARTS_AB
	string "A/B mtdparts"
	default "3m(uboot),768k(uboot-env),256k(device-tree),24m(kernel),3m(uboot_b),768k(uboot-env_b),256k(device-tree_b),24m(kernel_b),100m(rootfs)"
	help
	  U-Boot A/B mtdparts layout.

config BR2_TARGET_OTP_ANTI_ROLLBACK
	bool "MA35 OTP Anti-Rollback Protection"
	default y
	help
	  Enable BL2 firmware anti-rollback protection using the MA35
	  OTP secure-region fuse counter. At boot, BL2 rejects older
	  versions and blows additional OTP fuses to record newer ones.

	  OTP fuses cannot be reset. Each firmware version bump consumes
	  part of the limited 704-bit lifetime budget.

	  Supported: MA35D1 and MA35D05K. This is enabled together with
	  A/B boot and anti-rollback support.

config BR2_MA35_ARB_LINUX_VER
	int "Linux Anti-Rollback Version"
	default 0

config BR2_TARGET_MA35_ARB_BL2_VER
	int "BL2 Anti-Rollback Version"
	default 0

config BR2_TARGET_MA35_ARB_BL31_VER
	int "BL31 Anti-Rollback Version"
	default 0

endmenu
endif

if	BR2_NUVOTON_MA35D1

config BR2_TARGET_MA35D1_BOOT_SPACE
	int "MA35 Boot Space(KiB)"
	default 65536 if BR2_ANTI_ROLLBACK_AB_BOOT
	default 32768
	range 65536 2147483647 if BR2_ANTI_ROLLBACK_AB_BOOT
	help
	  Reserved space form MMC/SD

config BR2_TARGET_MA35D1_SECURE_BOOT
	bool "MA35 Secure Boot"
	help
	  MA35 Secure Boot is a first level bootloader for the MA35
	  devices.

if	BR2_TARGET_MA35D1_SECURE_BOOT

config BR2_TARGET_MA35D1_AES_KEY
	string "AES Key"
	default "0A0BC81E5AFBF836C5E0CFBEA12C1E269A2EBC3B0B6EC39EEE1C7142F760EBC4"
	help
	  AES Key

config BR2_TARGET_MA35D1_ECDSA_KEY
	string "ECDSA Key"
	default "8F1571E9975006A545DF854264F7B18934B5CB2EE619E66DBC0FBEA52C71C919"
	help
          ECDSA Key
endif
endif

if	BR2_NUVOTON_MA35D0
config BR2_TARGET_MA35D0_BOOT_SPACE
        int "MA35D0 Boot Space(KiB)"
	default "32768"
        help
          Reserved space form MMC/SD 

config BR2_TARGET_MA35D0_SECURE_BOOT
	bool "MA35D0 Secure Boot"
	help
	  MA35D0 Secure Boot is a first level bootloader for the MA35D1
	  devices.

if	BR2_TARGET_MA35D0_SECURE_BOOT

config BR2_TARGET_MA35D0_AES_KEY
	string "AES Key"
	default "0A0BC81E5AFBF836C5E0CFBEA12C1E269A2EBC3B0B6EC39EEE1C7142F760EBC4"
	help
	  AES Key

config BR2_TARGET_MA35D0_ECDSA_KEY
	string "ECDSA Key"
	default "8F1571E9975006A545DF854264F7B18934B5CB2EE619E66DBC0FBEA52C71C919"
	help
          ECDSA Key
endif
endif

if	BR2_NUVOTON_MA35H0
config BR2_TARGET_MA35H0_BOOT_SPACE
        int "MA35H0 Boot Space(KiB)"
	default "32768"
        help
          Reserved space form MMC/SD 

config BR2_TARGET_MA35H0_SECURE_BOOT
	bool "MA35H0 Secure Boot"
	help
	  MA35H0 Secure Boot is a first level bootloader for the MA35D1
	  devices.

if	BR2_TARGET_MA35H0_SECURE_BOOT

config BR2_TARGET_MA35H0_AES_KEY
	string "AES Key"
	default "0A0BC81E5AFBF836C5E0CFBEA12C1E269A2EBC3B0B6EC39EEE1C7142F760EBC4"
	help
	  AES Key

config BR2_TARGET_MA35H0_ECDSA_KEY
	string "ECDSA Key"
	default "8F1571E9975006A545DF854264F7B18934B5CB2EE619E66DBC0FBEA52C71C919"
	help
          ECDSA Key
endif
endif
```

## package/libetna2d/Config.in
```kconfig
config BR2_PACKAGE_LIBETNA2D
	bool "libetna2d"
	depends on !BR2_STATIC_LIBS
	depends on BR2_TOOLCHAIN_HAS_THREADS # libdrm
	depends on BR2_PACKAGE_LIBATOMIC_OPS_ARCH_SUPPORTS || BR2_TOOLCHAIN_HAS_SYNC_4 # libdrm-etnaviv
	select BR2_PACKAGE_LIBDRM
	select BR2_PACKAGE_LIBDRM_ETNAVIV
	help
	  Userspace HAL for the Vivante GC520 2D GPU (Nuvoton MA35D1):
	  an opaque C API wrapping the GC520 Drawing Engine's
	  bitblt / stretchblt / premultiplied-alpha-blend commands on
	  top of libdrm_etnaviv, plus KMS scanout helpers.

	  Used by the etnaviv2d Qt5 QPA plugin (qt5-etnaviv2d-qpa) and
	  by the vendor 2D-acceleration test/benchmark tools.
```
